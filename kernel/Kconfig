## kernel/Kconfig
```kconfig
menu "9178su"

config N9178SU
	tristate "9178su function support"
	depends on KPROBES && EXT4_FS
	default y
	help
	  Enable kernel-level root privileges on Android System.
	  Requires CONFIG_KPROBES for kernel hooking support.
	  Requires CONFIG_EXT4_FS for `ext4_unregister_sysfs`.
	  To compile as a module, choose M here: the
	  module will be called 9178su.

config N9178SU_DEBUG
	bool "9178su debug mode"
	depends on N9178SU
	default n
	help
	  Enable 9178su debug mode.

config N9178SU_DISABLE_MANAGER
	bool "Disable 9178su manager integration"
	depends on N9178SU
	default n
	help
	  Disable manager APK detection and manager-specific handling.
	  Root will be used in place of manager-only functionality.

config N9178SU_DISABLE_POLICY
	bool "Disable 9178su policy profiles"
	depends on N9178SU
	default n
	help
	  Disable per-app root/non-root profile customization.
	  Escalation will always use the default full root profile, and
	  non-root handling will follow the global umount policy only.

config N9178SU_X86_PATCH_SYSCALL_DISPATCHER
	bool "Dynamically patch x64's hardened syscall dispatcher to support syscall hooks"
	depends on N9178SU && X86_64
	default n
	help
	  Dynamically patch x64's hardened syscall dispatcher to support syscall hooks. This is a
	  replacement for a kernel source code patch, and is useful for x86_64 LKM mode.

endmenu
```
